## config/boards/arm/jaye/Kconfig.board
```kconfig
   
config BOARD_JAYE_LEFT
	bool "jaye_left"
	depends on SOC_NRF52840_QIAA

config BOARD_JAYE_RIGHT
	bool "jaye_right"
	depends on SOC_NRF52840_QIAA
```

## config/boards/arm/jaye/Kconfig.defconfig
```kconfig
# Copyright (c) 2021 Rafael Yumagulov
# SPDX-License-Identifier: MIT

if BOARD_JAYE_LEFT

	config ZMK_KEYBOARD_NAME
	default "Jaye"

    config ZMK_SPLIT_ROLE_CENTRAL
	default y

endif # BOARD_JAYE_LEFT

if BOARD_JAYE_LEFT || BOARD_JAYE_RIGHT

config BOARD
	default "jaye"

config ZMK_SPLIT
	default y

config BT_CTLR
	default BT

# config ZMK_BATTERY_VOLTAGE_DIVIDER
# 	default y

if USB

config USB_NRFX
	default y

config USB_DEVICE_STACK
	default y

endif # USB_DEVICE_STACK
endif # BOARD_JAYE_LEFT || BOARD_JAYE_RIGHT



config RGBLED_WIDGET
    bool "Enable RGB LED widget for showing battery and output status"

if RGBLED_WIDGET

config LED
    default y

config RGBLED_WIDGET_BATTERY_BLINK_MS
    int "Duration of battery level blink in ms"
    default 2000

config RGBLED_WIDGET_OUTPUT_BLINK_MS
    int "Duration of BLE connection status blink in ms"
    default 1000

config RGBLED_WIDGET_INTERVAL_MS
    int "Minimum wait duration between two blinks in ms"
    default 500

config RGBLED_WIDGET_BATTERY_LEVEL_HIGH
    int "High battery level percentage"
    default 99

config RGBLED_WIDGET_BATTERY_LEVEL_LOW
    int "Low battery level percentage"
    default 20

config RGBLED_WIDGET_BATTERY_LEVEL_CRITICAL
    int "Critical battery level percentage"
    default 10

config RGBLED_WIDGET_SHOW_LAYER_CHANGE
    bool "Indicate highest active layer on each layer change with a sequence of blinks"

config RGBLED_WIDGET_LAYER_BLINK_MS
    int "Blink and wait duration for layer indicator"
    default 100

endif
```

## config/boards/arm/jaye/Kconfig.shield
```kconfig
config SHIELD_JAYE_LEFT
    def_bool $(shields_list_contains,jaye_left)

config SHIELD_JAYE_RIGHT
    def_bool $(shields_list_contains,jaye_right)
```

## config/boards/shields/jaye/Kconfig.shield
```kconfig
# Copyright (c) 2020 The ZMK Contributors
# SPDX-License-Identifier: MIT

config SHIELD_JAYE_LEFT
	def_bool $(shields_list_contains,jaye_left)

config SHIELD_JAYE_RIGHT
	def_bool $(shields_list_contains,jaye_right)
```

## config/west.yml
```yaml
manifest:
  remotes:
    - name: zmkfirmware
      url-base: https://github.com/zmk/zmk-firmware
  projects:
    - name: zmk-firmware
      remote: zmkfirmware
      revision: main
      import: app/west.yml
  self:
    path: config
```
